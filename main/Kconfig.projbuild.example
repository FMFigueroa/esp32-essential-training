## main/Kconfig.projbuild.example
```kconfig
menu "WIFI"

    config SSID
        string "SSID"
        default "My_WiFi"

    config PASSWORD
        string "PASSWORD"
        default "12345"
endmenu
```
